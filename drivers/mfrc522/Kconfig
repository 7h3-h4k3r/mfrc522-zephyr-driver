## drivers/mfrc522/Kconfig
```kconfig
menuconfig MFRC522
    bool "MFRC522 13.16 MHz RFID reader driver"
    default y
    depends on DT_HAS_NXP_MFRC522_ENABLED
    select SPI
    select GPIO
    help
      Enable drivers for the MFRC522 contactless RFID reader.
    
if MFRC522

config MFRC522_INIT_PRIORITY
        int "MFRC522 initialization priority"
        default 90
        help
          Device driver initialization priority 

module = MFRC522
module-str = mfrc522
source "subsys/logging/Kconfig.template.log_config"

endif #MFRC522
```
